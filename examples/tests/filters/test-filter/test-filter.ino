#include "AudioTools.h"


double coefd[137] = {
    0.000188725585189891,  0.000091879473225926,  -0.000016920442768766,
    -0.000133280461026043, -0.000251640080720683, -0.000364923626390918,
    -0.000464412185430885, -0.000539946399700805, -0.000580528007418057,
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    0.000091879473225926,  0.000188725585189891};


float  coeff[137];
int16_t coef16[137];
int32_t coef32[137];
int64_t coef64[137];

static int16_t const max_array = 300;
int16_t result_array[max_array];

void setupCoef() {
  for (int j=0;j<137;j++){
    coeff[j] = coefd[j];
    coef16[j] = coefd[j]*32767;
    coef32[j] = coefd[j]*32767;
    coef64[j] = coefd[j]*32767;
  }
}

void listResult() {
  for (int j = 0; j < 200; j++) {
    Serial.print(result_array[j]);
    Serial.print(" ");
  }
}

void processFloat() {
FIR<float> firf(coeff);
  unsigned long start = millis();
  for (int j = 0; j < 44100; j++) {
    auto result = firf.process(32767);
    if (j < max_array) {
      result_array[j] = result;
    }
  }
  Serial.println();
  Serial.print("float ms: ");
  Serial.println(millis() - start);
}

void processDouble() {
  FIR<double> fird(coefd);
  unsigned long start = millis();
  for (int j = 0; j < 44100; j++) {
    auto result = fird.process(32767);
    if (j < max_array) {
      result_array[j] = result;
    }
  }
  Serial.println();
  Serial.print("double ms: ");
  Serial.println(millis() - start);
}

void processInt16() {
  FIR<int16_t> fir16(coef16, 32767);
  unsigned long start = millis();
  for (int j = 0; j < 44100; j++) {
    auto result = fir16.process(32767);
    if (j < max_array) {
      result_array[j] = result;
    }
  }
  Serial.println();
  Serial.print("int16 ms: ");
  Serial.println(millis() - start);
}

void processInt32() {
  FIR<int32_t> fir32(coef32, 32767);
  unsigned long start = millis();
  for (int j = 0; j < 44100; j++) {
    auto result = fir32.process(32767);
    if (j < max_array) {
      result_array[j] = result;
    }
  }
  Serial.println();
  Serial.print("int32 ms: ");
  Serial.println(millis() - start);
}

void processInt64() {
  FIR<int64_t> fir64(coef64, 32767);
  unsigned long start = millis();
  for (int j = 0; j < 44100; j++) {
    auto result = fir64.process(32767);
    if (j < max_array) {
      result_array[j] = result;
    }
  }
  Serial.println();
  Serial.print("int64 ms: ");
  Serial.println(millis() - start);
}


void setup() {
  Serial.begin(119200);
  while (!Serial)
    ;
  setupCoef();
  processFloat();
  listResult();
  processDouble();
  listResult();
  // processInt16();
  // listResult();
  processInt32();
  listResult();
  processInt64();
  listResult();
}

void loop() {}