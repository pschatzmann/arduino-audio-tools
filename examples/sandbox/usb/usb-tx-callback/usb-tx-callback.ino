/**
 * @file usb-tx-callback.ino
 * @brief USB Audio TX using USBAudioDevice directly with a callback.
 *
 * This example shows the lower-level API: instead of using USBAudioStream,
 * the application registers a TX callback directly on USBAudioDevice and
 * drives the pump loop itself.  USBAudioDevice is a platform alias — it
 * resolves to USBAudioDeviceTinyUSB (RP2040) or USBAudioDeviceESP32
 * automatically via the USBAudioDevice.h dispatch header.
 *
 * TX callback (device → host, i.e. microphone / capture):
 *   Called by process() each millisecond to fill one USB isochronous packet.
 *   The example feeds a sine wave generated by AudioTools.
 *
 * @note this example is more efficient than usb-tx.ino because it avoids the
 * overhead of the USBAudioStream layer, but it also requires more manual
 * handling of the USB stack and audio generation.
 *
 * @note for ESP32: Board settings (Arduino IDE):
 *   Tools → Board            : ESP32S3 Dev Module (or your board)
 *   Tools → USB Mode         : USB-OTG (TinyUSB)
 *   Tools → USB CDC On Boot  : Disabled
 *   If you want to use the CDC serial port for logging: define USBCDC
 * USBSerial; and use USBSerial!
 * 
 * @note for boards using Adafruit TinyUSB core (e.g. RP2040, STM32, SAMD):
 * Board settings (Arduino IDE): USB Mode: USB OTG (TinyUSB)
 *
 * @author Phil Schatzmann
 * @copyright GPLv3
 */
#include "AudioTools.h"
#include "AudioTools/Sandbox/USB/USBAudioDevice.h"

AudioInfo info(44100, 2, 16);
SineGenerator<int16_t> sine(32000);
GeneratedSoundStream<int16_t> sound(sine);
USBAudioDevice dev;

// ── TX callback: fill each USB packet with sine audio ────────────────────────
uint16_t onTx(uint8_t* data, uint16_t len) {
  return (uint16_t)sound.readBytes(data, len);
}

void setup() {
  // Manual begin() is required on core without built-in support e.g. mbed rp2040
  if (!TinyUSBDevice.isInitialized()) {
    TinyUSBDevice.begin(0);
  }

  Serial.begin(115200);
  while(!Serial) delay(100);
  Serial.println("starting...");
  AudioToolsLogger.begin(Serial, AudioToolsLogLevel::Info);

  // start generating the sine wave at 440 Hz (A4) with the default audio config
  sine.begin(info, N_B4);

  USBAudioConfig cfg = dev.defaultConfig(TX_MODE);
  cfg.copyFrom(info);
  cfg.begin_usb = true;
  dev.setTxCallback(onTx);
  dev.begin(cfg);  // begin() calls beginUSB() internally

  // If already enumerated, additional class driverr begin() e.g msc, hid, midi won't take effect until re-enumeration
  if (TinyUSBDevice.mounted()) {
    TinyUSBDevice.detach();
    delay(10);
    TinyUSBDevice.attach();
  }
}

void loop() {
  dev.process();  // drives tud_task() on TinyUSB platforms + TX callback → USB FIFO
}
